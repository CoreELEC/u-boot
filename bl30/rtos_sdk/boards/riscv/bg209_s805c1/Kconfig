## bl30/rtos_sdk/boards/riscv/bg209_s805c1/Kconfig
```kconfig
# Copyright (c) 2021-2022 Amlogic, Inc. All rights reserved.

# SPDX-License-Identifier: MIT

config BOARD_BG209_S805C1
	bool "Amlogic BG209_S805C1 Board"
	select SOC_S1A
	select LIBC_AML
	select COMMON
	select GET_VERSION
	select STICK_MEM
	select UART
	select CEC
	select MAILBOX
	select STR
	select GPIO
	select KEY
	select PWM
	select TIMER_SOURCE
	select SARADC
	select IR
	select ETHERNET
	select VRTC
	select HWSPINLOCK
	select VERSION_FULL_INFO
	help
	  Enable Amlogic BG209_S805C1 Board.
```

## bl30/rtos_sdk/boards/riscv/bh201_s905y5/Kconfig
```kconfig
# Copyright (c) 2021-2022 Amlogic, Inc. All rights reserved.

# SPDX-License-Identifier: MIT

config BOARD_BH201_S905Y5
	bool "Amlogic BH201_S905Y5 Board"
	select SOC_S7
	select LIBC_AML
	select COMMON
	select GET_VERSION
	select STICK_MEM
	select UART
	select CEC
	select MAILBOX
	select STR
	select GPIO
	select KEY
	select PWM
	select LEDS
#	select I2C_SLAVE
	select TIMER_SOURCE
	select SARADC
	select IR
	select ETHERNET
	select VRTC
	select VERSION_FULL_INFO
	select AOCPU_ALIVE_DETECTION
	help
	  Enable Amlogic BH201_S905Y5 Board.
```

## bl30/rtos_sdk/boards/riscv/bh201_s905y5/defconfig
```kconfig
#
# Copyright (c) 2021-2022 Amlogic, Inc. All rights reserved.
#
# SPDX-License-Identifier: MIT
#

CONFIG_BOARD_BH201_S905Y5=y
```

## bl30/rtos_sdk/boards/riscv/bh209_s905y5/Kconfig
```kconfig
# Copyright (c) 2021-2022 Amlogic, Inc. All rights reserved.

# SPDX-License-Identifier: MIT

config BOARD_BH209_S905Y5
	bool "Amlogic BH209_S905Y5 Board"
	select SOC_S7
	select LIBC_AML
	select COMMON
	select GET_VERSION
	select STICK_MEM
	select UART
	select CEC
	select MAILBOX
	select STR
	select GPIO
	select KEY
	select PWM
	select LEDS
#	select I2C_SLAVE
	select TIMER_SOURCE
	select SARADC
	select IR
	select ETHERNET
	select VRTC
	select VERSION_FULL_INFO
	help
	  Enable Amlogic BH209_S905Y5 Board.
```

## bl30/rtos_sdk/boards/riscv/bm201_s905x5m/Kconfig
```kconfig
# Copyright (c) 2021-2022 Amlogic, Inc. All rights reserved.

# SPDX-License-Identifier: MIT

config BOARD_BM201_S905X5M
	bool "Amlogic BM201_S905X5M Board"
	select SOC_S7D
	select LIBC_AML
	select COMMON
	select GET_VERSION
	select STICK_MEM
	select UART
	select CEC
	select MAILBOX
	select STR
	select GPIO
	select KEY
	select PWM
	select LEDS
#	select I2C_SLAVE
	select TIMER_SOURCE
	select SARADC
	select IR
	select ETHERNET
	select VRTC
	select VERSION_FULL_INFO
	select AOCPU_ALIVE_DETECTION
	help
	  Enable Amlogic BM201_S905X5M Board.
```

## bl30/rtos_sdk/boards/riscv/bm202_s905x5m/defconfig
```kconfig
#
# Copyright (c) 2021-2022 Amlogic, Inc. All rights reserved.
#
# SPDX-License-Identifier: MIT
#

CONFIG_BOARD_BM202_S905X5M=y
```

## bl30/rtos_sdk/boards/riscv/bp202_s805x3/Kconfig
```kconfig
# Copyright (c) 2021-2022 Amlogic, Inc. All rights reserved.

# SPDX-License-Identifier: MIT

config BOARD_BP202_S805X3
	bool "Amlogic BP202_S805X3 Board"
	select SOC_S7
	select LIBC_AML
	select COMMON
	select GET_VERSION
	select STICK_MEM
	select UART
	select CEC
	select MAILBOX
	select STR
	select GPIO
	select KEY
	select PWM
	select LEDS
#	select I2C_SLAVE
	select TIMER_SOURCE
	select SARADC
	select IR
	select ETHERNET
	select VRTC
	select VERSION_FULL_INFO
	help
	  Enable Amlogic BP202_S805X3 Board.
```

## bl30/rtos_sdk/boards/riscv/bp202_s805x3/defconfig
```kconfig
#
# Copyright (c) 2021-2022 Amlogic, Inc. All rights reserved.
#
# SPDX-License-Identifier: MIT
#

CONFIG_BOARD_BP202_S805X3=y
```

## bl30/rtos_sdk/boards/riscv/s1a_skt/Kconfig
```kconfig
# Copyright (c) 2021-2022 Amlogic, Inc. All rights reserved.

# SPDX-License-Identifier: MIT

config BOARD_S1A_SKT
	bool "Amlogic S1A_SKT Board"
	select SOC_S1A
	select LIBC_AML
	select COMMON
	select GET_VERSION
	select STICK_MEM
	select UART
	select CEC
	select MAILBOX
	select STR
	select GPIO
	select KEY
	select PWM
	select TIMER_SOURCE
	select SARADC
	select IR
	select ETHERNET
	select VRTC
	select HWSPINLOCK
	select VERSION_FULL_INFO
	help
	  Enable Amlogic S1A_SKT Board.
```

## bl30/rtos_sdk/boards/riscv/s5_skt/Kconfig
```kconfig
# Copyright (c) 2021-2022 Amlogic, Inc. All rights reserved.

# SPDX-License-Identifier: MIT

config BOARD_SKT_S5
	bool "Amlogic SKT Board"
	select SOC_S5
	help
	  Enable Amlogic SKT Board.
```

## bl30/rtos_sdk/boards/riscv/s6_skt/Kconfig
```kconfig
# Copyright (c) 2021-2022 Amlogic, Inc. All rights reserved.

# SPDX-License-Identifier: MIT

config BOARD_S6_SKT
	bool "Amlogic S6_SKT Board"
	select SOC_S6
	select BRINGUP
	select LIBC_AML
	select COMMON
	select GET_VERSION
#	select STICK_MEM
	select UART
	select CEC
	select MAILBOX
	select STR
	select GPIO
	select KEY
	select PWM
	select LEDS
#	select I2C_SLAVE
	select TIMER_SOURCE
	select SARADC
	select IR
	select ETHERNET
	select VRTC
	select VERSION_FULL_INFO
	help
	  Enable Amlogic S6_SKT Board.
```

## bl30/rtos_sdk/boards/riscv/s7_skt/Kconfig
```kconfig
# Copyright (c) 2021-2022 Amlogic, Inc. All rights reserved.

# SPDX-License-Identifier: MIT

config BOARD_S7_SKT
	bool "Amlogic S7_SKT Board"
	select SOC_S7
	select LIBC_AML
	select COMMON
	select GET_VERSION
	select STICK_MEM
	select UART
	select CEC
	select MAILBOX
	select STR
	select GPIO
	select KEY
	select PWM
	select LEDS
#	select I2C_SLAVE
	select TIMER_SOURCE
	select SARADC
	select IR
	select ETHERNET
	select VRTC
	select VERSION_FULL_INFO
	help
	  Enable Amlogic S7_SKT Board.
```

## bl30/rtos_sdk/boards/riscv/s7d_skt/Kconfig
```kconfig
# Copyright (c) 2021-2022 Amlogic, Inc. All rights reserved.

# SPDX-License-Identifier: MIT

config BOARD_S7D_SKT
	bool "Amlogic S7D_SKT Board"
	select SOC_S7D
	select LIBC_AML
	select COMMON
	select GET_VERSION
	select STICK_MEM
	select UART
	select CEC
	select MAILBOX
	select STR
	select GPIO
	select KEY
	select PWM
	select LEDS
#	select I2C_SLAVE
	select TIMER_SOURCE
	select SARADC
	select IR
	select ETHERNET
	select VRTC
	select VERSION_FULL_INFO
	help
	  Enable Amlogic S7D_SKT Board.
```

## bl30/rtos_sdk/boards/riscv/t223_s905y5r/Kconfig
```kconfig
# Copyright (c) 2021-2022 Amlogic, Inc. All rights reserved.

# SPDX-License-Identifier: MIT

config BOARD_T223_S905Y5R
	bool "Amlogic T223_S905Y5R Board"
	select SOC_S7
	select LIBC_AML
	select COMMON
	select GET_VERSION
	select STICK_MEM
	select UART
	select CEC
	select MAILBOX
	select STR
	select GPIO
	select KEY
	select PWM
	select LEDS
#	select I2C_SLAVE
	select TIMER_SOURCE
	select SARADC
	select IR
	select ETHERNET
	select VRTC
	select VERSION_FULL_INFO
	help
	  Enable Amlogic T223_S905Y5R Board.
```

## bl30/rtos_sdk/boards/riscv/t223_s905y5r/defconfig
```kconfig
#
# Copyright (c) 2021-2022 Amlogic, Inc. All rights reserved.
#
# SPDX-License-Identifier: MIT
#

CONFIG_BOARD_T223_S905Y5R=y
```

## bl30/rtos_sdk/boards/riscv/t5m_skt/Kconfig
```kconfig
# Copyright (c) 2021-2022 Amlogic, Inc. All rights reserved.

# SPDX-License-Identifier: MIT

config BOARD_SKT_T5M
	bool "Amlogic T5M SKT Board"
	select SOC_T5M
	select LIBC_AML
	select COMMON
	select GET_VERSION
	select STICK_MEM
	select UART
	select CEC
	select MAILBOX
	select STR
	select GPIO
	select KEY
	select PWM
	select LEDS
	select TIMER_SOURCE
	select SARADC
	select IR
	select VRTC
	select HWSPINLOCK
	select VERSION_FULL_INFO
	help
	  Enable Amlogic T5M SKT Board.
```

## bl30/rtos_sdk/boards/riscv/t6d_skt/defconfig
```kconfig
#
# Copyright (c) 2021-2022 Amlogic, Inc. All rights reserved.
#
# SPDX-License-Identifier: MIT
#
CONFIG_BOARD_T6D_SKT=y
```

## bl30/rtos_sdk/boards/riscv/txhd2_skt/Kconfig
```kconfig
# Copyright (c) 2021-2022 Amlogic, Inc. All rights reserved.

# SPDX-License-Identifier: MIT

config BOARD_TXHD2_SKT
	bool "Amlogic TXHD2_SKT Board"
	select SOC_TXHD2
	select LIBC_AML
	select COMMON
	select GET_VERSION
#	select STICK_MEM
	select UART
	select CEC
	select DDR
	select MAILBOX
	select VRTC
	select STR
	select GPIO
	select KEY
	select PWM
	# select LEDS
	select TIMER_SOURCE
	select SARADC
	select IR
	select ETHERNET
	select VERSION_FULL_INFO
	help
	  Enable Amlogic TXHD2_SKT Board.
```

## bl30/rtos_sdk/boards/riscv/txhd2_skt/defconfig
```kconfig
#
# Copyright (c) 2021-2022 Amlogic, Inc. All rights reserved.
#
# SPDX-License-Identifier: MIT
#

CONFIG_BOARD_TXHD2_SKT=y
```

## bl30/rtos_sdk/drivers_aocpu/Kconfig
```kconfig
# Copyright (c) 2021-2022 Amlogic, Inc. All rights reserved.

# SPDX-License-Identifier: MIT

rsource "stick_mem/Kconfig"
rsource "uart/Kconfig"
rsource "cec/Kconfig"
rsource "ddr/Kconfig"
rsource "mailbox/Kconfig"
rsource "vrtc/Kconfig"
rsource "str/Kconfig"
rsource "gpio/Kconfig"
rsource "key/Kconfig"
rsource "pwm/Kconfig"
rsource "leds/Kconfig"
rsource "fd650/Kconfig"
rsource "timer_source/Kconfig"
rsource "saradc/Kconfig"
rsource "ir/Kconfig"
rsource "rtc/Kconfig"
rsource "hwspinlock/Kconfig"
rsource "i2c/Kconfig"
rsource "i2c_slave/Kconfig"
rsource "ethernet/Kconfig"
rsource "hdmirx/Kconfig"
rsource "pm/Kconfig"
```

## bl30/rtos_sdk/drivers_aocpu/cec/Kconfig
```kconfig
# Copyright (c) 2021-2022 Amlogic, Inc. All rights reserved.

# SPDX-License-Identifier: MIT

config CEC
	bool "CEC Driver"
```

## bl30/rtos_sdk/drivers_aocpu/ethernet/Kconfig
```kconfig
# Copyright (c) 2021-2022 Amlogic, Inc. All rights reserved.

# SPDX-License-Identifier: MIT

config ETHERNET
	bool "Ethernet Driver"
	help
	  Enable Ethernet Driver.
```

## bl30/rtos_sdk/drivers_aocpu/fd650/Kconfig
```kconfig
# Copyright (c) 2021-2022 Amlogic, Inc. All rights reserved.

# SPDX-License-Identifier: MIT

config FD650
	bool "FD650 Display Driver"
	help
	  Enable FD650 Display Driver.
```

## bl30/rtos_sdk/lib/libc/test/Kconfig
```kconfig
# Copyright (c) 2023-2024 Amlogic, Inc. All rights reserved.

# SPDX-License-Identifier: MIT

config LIBC_TEST
	bool "Libc unity test"
    default y
	help
	  Libc unity test
```

## bl30/rtos_sdk/soc/riscv/Kconfig
```kconfig
# Copyright (c) 2021-2022 Amlogic, Inc. All rights reserved.

# SPDX-License-Identifier: MIT

rsource "${SOC}/Kconfig"

config SOC_OLD_ARCH
	bool "Soc Old Arch"
	help
	  chip old architecture
```

## bl30/rtos_sdk/soc/riscv/a4/Kconfig
```kconfig
# Copyright (c) 2021-2022 Amlogic, Inc. All rights reserved.

# SPDX-License-Identifier: MIT

config SOC_A4
	bool "A4"
	select RISCV
	help
	  Enable A4 SOC of RISCV.
```

## bl30/rtos_sdk/soc/riscv/t3x/Kconfig
```kconfig
# Copyright (c) 2021-2022 Amlogic, Inc. All rights reserved.

# SPDX-License-Identifier: MIT

config SOC_T3X
	bool "T3X"
	select RISCV
	help
	  Enable T3X SOC of RISCV.
```

## bl30/rtos_sdk/soc/riscv/t5d/Kconfig
```kconfig
# Copyright (c) 2021-2022 Amlogic, Inc. All rights reserved.

# SPDX-License-Identifier: MIT

config SOC_T5D
	bool "T5D"
	select RISCV
	help
	  Enable T5D SOC of RISCV.

choice
	prompt "Serial"
	default N200_REVA
	config N200_REVA
	bool "N200 REVA"
	help
	  Enable N200 REVA serial of RISCV.
endchoice
```

## bl30/rtos_sdk/soc/riscv/t5w/Kconfig
```kconfig
# Copyright (c) 2021-2022 Amlogic, Inc. All rights reserved.

# SPDX-License-Identifier: MIT

config SOC_T5W
	bool "T5W"
	select RISCV
	select SOC_OLD_ARCH
	help
	  Enable T5W SOC of RISCV.

choice
	prompt "Serial"
	default N200_REVA
	config N200_REVA
	bool "N200 REVA"
	help
	  Enable N200 REVA serial of RISCV.
endchoice
```

## board/amlogic/libretech_cc/Kconfig
```kconfig
if TARGET_MESON_GX

config SYS_CPU
	string
	default "armv8"

config SYS_BOARD
	string
	default "libretech_cc"

config SYS_VENDOR
	string
	default "amlogic"

config SYS_SOC
	string
	default "gxl"

config SYS_CONFIG_NAME
	default "libretech_cc"

endif
```

## board/h96proplus/Kconfig
```kconfig
config H96PROPLUS_V2_2
	bool "Support H96Pro+ v2.2 q201 board"
	default n

config H96PROPLUS_V5_V6
	bool "Support H96Pro+ v5/v6 q201 board"
	default n

if H96PROPLUS_V2_2
source "board/h96proplus/v2_2/Kconfig"
endif

if H96PROPLUS_V5_V6
source "board/h96proplus/v5_v6/Kconfig"
endif
```

## board/h96proplus/defconfigs/h96proplus_v2_2_defconfig
```kconfig
CONFIG_ARM=y
CONFIG_TARGET_MESON_GX=y
CONFIG_H96PROPLUS_V2_2=y
CONFIG_DM=y
CONFIG_DM_GPIO=y
CONFIG_AML_GPIO=y
```

## board/h96proplus/defconfigs/h96proplus_v5_v6_defconfig
```kconfig
CONFIG_ARM=y
CONFIG_TARGET_MESON_GX=y
CONFIG_H96PROPLUS_V5_V6=y
CONFIG_DM=y
CONFIG_DM_GPIO=y
CONFIG_AML_GPIO=y
```

## board/h96proplus/v2_2/Kconfig
```kconfig
if TARGET_MESON_GX

config SYS_CPU
	string
	default "armv8"

config SYS_BOARD
	string
	default "v2_2"

config SYS_VENDOR
	string
	default "h96proplus"

config SYS_SOC
	string
	default "gxl"

config SYS_CONFIG_NAME
	default "v2_2"

endif
```

## board/h96proplus/v5_v6/Kconfig
```kconfig
if TARGET_MESON_GX

config SYS_CPU
	string
	default "armv8"

config SYS_BOARD
	string
	default "v5_v6"

config SYS_VENDOR
	string
	default "h96proplus"

config SYS_SOC
	string
	default "gxl"

config SYS_CONFIG_NAME
	default "v5_v6"

endif
```

## board/librecomputer/alta/Kconfig
```kconfig
if TARGET_MESON_G12B

config SYS_CPU
	string
	default "armv8"

config SYS_BOARD
	string
	default "alta"

config SYS_VENDOR
	string
	default "librecomputer"

config SYS_SOC
	string
	default "g12b"

config SYS_CONFIG_NAME
	default "alta"

endif
```

## board/librecomputer/solitude/Kconfig
```kconfig
if TARGET_MESON_G12A

config SYS_CPU
	string
	default "armv8"

config SYS_BOARD
	string
	default "solitude"

config SYS_VENDOR
	string
	default "librecomputer"

config SYS_SOC
	string
	default "g12a"

config SYS_CONFIG_NAME
	default "solitude"

endif
```

## board/radxa/radxa_zero/Kconfig
```kconfig
if TARGET_MESON_G12A

config SYS_CPU
	string
	default "armv8"

config SYS_BOARD
	string
	default "radxa_zero"

config SYS_VENDOR
	string
	default "radxa"

config SYS_SOC
	string
	default "g12a"

config SYS_CONFIG_NAME
	default "radxa_zero"

endif
```

## board/radxa/radxa_zero2/Kconfig
```kconfig
if TARGET_MESON_G12B

config SYS_CPU
	string
	default "armv8"

config SYS_BOARD
	string
	default "radxa_zero2"

config SYS_VENDOR
	string
	default "radxa"

config SYS_SOC
	string
	default "g12b"

config SYS_CONFIG_NAME
	default "radxa_zero2"

endif
```

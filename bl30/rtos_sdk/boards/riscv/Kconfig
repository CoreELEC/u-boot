## bl30/rtos_sdk/boards/riscv/Kconfig
```kconfig
# Copyright (c) 2021-2022 Amlogic, Inc. All rights reserved.

# SPDX-License-Identifier: MIT

config BL30_VERSION_SAVE
	bool "BL30 VERSION SAVE"
	help
	  Enable BL30 VERSION SAVE.

config BRINGUP
	bool "BL30 BRINGUP BOARD"
	help
	  Mark as bringup board.

rsource "${BOARD}/Kconfig"
```

## bl30/rtos_sdk/boards/riscv/a4_skt/defconfig
```kconfig
#
# Copyright (c) 2021-2022 Amlogic, Inc. All rights reserved.
#
# SPDX-License-Identifier: MIT
#

CONFIG_BOARD_SKT_A4=y
```

## bl30/rtos_sdk/boards/riscv/am301_t950d4/Kconfig
```kconfig
# Copyright (c) 2021-2022 Amlogic, Inc. All rights reserved.

# SPDX-License-Identifier: MIT

config BOARD_AM301_T950D4
	bool "Amlogic AM301 Board"
	select SOC_T5D
	select LIBC_AML
	select COMMON
	select GET_VERSION
	select STICK_MEM
	select UART
	select CEC
	select DDR
	select MAILBOX
	select VRTC
	select STR
	select GPIO
	select KEY
	select PWM
	select LEDS
	select TIMER_SOURCE
	select SARADC
	select IR
	help
	  Enable Amlogic AM301 Board.
```

## bl30/rtos_sdk/boards/riscv/am301_t950d4/defconfig
```kconfig
#
# Copyright (c) 2021-2022 Amlogic, Inc. All rights reserved.
#
# SPDX-License-Identifier: MIT
#

CONFIG_BOARD_AM301_T950D4=y
```

## bl30/rtos_sdk/boards/riscv/at301_t962d4/Kconfig
```kconfig
# Copyright (c) 2021-2022 Amlogic, Inc. All rights reserved.

# SPDX-License-Identifier: MIT

config BOARD_AT301_T962D4
	bool "Amlogic AT301 Board"
	select SOC_T5W
	select LIBC_AML
	select COMMON
	select GET_VERSION
	select BL30_VERSION_SAVE
	select STICK_MEM
	select UART
	select CEC
	select DDR
	select MAILBOX
	select VRTC
	select STR
	select GPIO
	select KEY
	select PWM
	select LEDS
	select TIMER_SOURCE
	select SARADC
	select IR
	select ETHERNET
	select VERSION_FULL_INFO
	help
	  Enable Amlogic AT301 Board.
```

## bl30/rtos_sdk/boards/riscv/at301_t962d4/defconfig
```kconfig
#
# Copyright (c) 2021-2022 Amlogic, Inc. All rights reserved.
#
# SPDX-License-Identifier: MIT
#

CONFIG_BOARD_AT301_T962D4=y
```

## bl30/rtos_sdk/boards/riscv/at309_t962d4/Kconfig
```kconfig
# Copyright (c) 2021-2022 Amlogic, Inc. All rights reserved.

# SPDX-License-Identifier: MIT

config BOARD_AT309_T962D4
	bool "Amlogic AT309 Board"
	select SOC_T5W
	select COMMON
	select GET_VERSION
	select STICK_MEM
	select UART
	select CEC
	select DDR
	select MAILBOX
	select VRTC
	select STR
	select GPIO
	select KEY
	select PWM
	select LEDS
	select TIMER_SOURCE
	select SARADC
	select IR
	help
	  Enable Amlogic AT309 Board.
```

## bl30/rtos_sdk/boards/riscv/at309_t962d4/defconfig
```kconfig
CONFIG_BOARD_AT309_T5W=y
CONFIG_GET_VERSION=y
CONFIG_STICK_MEM=y
CONFIG_UART=y
CONFIG_CEC=y
CONFIG_MAILBOX=y
CONFIG_VRTC=y
CONFIG_STR=y
CONFIG_GPIO=y
CONFIG_KEY=y
CONFIG_PWM=y
CONFIG_TIMER_SOURCE=y
CONFIG_SARADC=y
CONFIG_IR=y
CONFIG_COMMON=y
```

## bl30/rtos_sdk/boards/riscv/av400_a113x2/Kconfig
```kconfig
# Copyright (c) 2021-2022 Amlogic, Inc. All rights reserved.

# SPDX-License-Identifier: MIT

config BOARD_AV400_A113X2
	bool "Amlogic AV400 Board"
	select SOC_A5
	select LIBC_AML
	select COMMON
	select GET_VERSION
	select STICK_MEM
	select UART
	select CEC
	select MAILBOX
	select STR
	select GPIO
	select KEY
	select PWM
	select LEDS
	select TIMER_SOURCE
	select SARADC
	select IR
	select ETHERNET
	select RTC
	select VERSION_FULL_INFO
	select BL30_VERSION_SAVE
	help
	  Enable Amlogic AV400 Board.
```

## bl30/rtos_sdk/boards/riscv/av400_a113x2/defconfig
```kconfig
#
# Copyright (c) 2021-2022 Amlogic, Inc. All rights reserved.
#
# SPDX-License-Identifier: MIT
#

CONFIG_BOARD_AV400_A113X2=y
```

## bl30/rtos_sdk/boards/riscv/av409_a113x2/Kconfig
```kconfig
# Copyright (c) 2021-2022 Amlogic, Inc. All rights reserved.

# SPDX-License-Identifier: MIT

config BOARD_AV409_A113X2
	bool "Amlogic AV409 Board"
	select SOC_A5
	select LIBC_AML
	select COMMON
	select GET_VERSION
	select STICK_MEM
	select UART
	select CEC
	select MAILBOX
	select RTC
	select STR
	select GPIO
	select KEY
	select PWM
	select LEDS
	select TIMER_SOURCE
	select SARADC
	select IR
	select ETHERNET
	select VERSION_FULL_INFO
	select BL30_VERSION_SAVE
	help
	  Enable Amlogic AV409 Board.
```

## bl30/rtos_sdk/boards/riscv/ax201_s928x/Kconfig
```kconfig
# Copyright (c) 2021-2022 Amlogic, Inc. All rights reserved.

# SPDX-License-Identifier: MIT

config BOARD_AX201_S928X
	bool "Amlogic AX201 Board"
	select SOC_S5
	help
	  Enable Amlogic AX201 Board.
```

## bl30/rtos_sdk/boards/riscv/ax201_s928x/defconfig
```kconfig
#
# Copyright (c) 2021-2022 Amlogic, Inc. All rights reserved.
#
# SPDX-License-Identifier: MIT
#
CONFIG_BOARD_AX201_S928X=y
```

## bl30/rtos_sdk/boards/riscv/ax208_s928x/Kconfig
```kconfig
# Copyright (c) 2021-2022 Amlogic, Inc. All rights reserved.

# SPDX-License-Identifier: MIT

config BOARD_AX208_S928X
	bool "Amlogic AX208 Board"
	select SOC_S5
	select COMMON
	select GET_VERSION
	select STICK_MEM
	select UART
	select CEC
	select MAILBOX
	select STR
	select GPIO
	select KEY
	select PWM
	select TIMER_SOURCE
	select SARADC
	select IR
	select VRTC
	help
	  Enable Amlogic AX208 Board.
```

## bl30/rtos_sdk/boards/riscv/ax209_s928x/Kconfig
```kconfig
# Copyright (c) 2021-2022 Amlogic, Inc. All rights reserved.

# SPDX-License-Identifier: MIT

config BOARD_AX209_S928X
	bool "Amlogic AX209 Board"
	select SOC_S5
	select LIBC_AML
	select COMMON
	select GET_VERSION
	select STICK_MEM
	select UART
	select CEC
	select MAILBOX
	select STR
	select GPIO
	select KEY
	select PWM
	select LEDS
	select TIMER_SOURCE
	select SARADC
	select IR
	select ETHERNET
	select VRTC
	select HWSPINLOCK
	select VERSION_FULL_INFO
	select BL30_VERSION_SAVE
	help
	  Enable Amlogic AX209 Board.
```

## bl30/rtos_sdk/boards/riscv/ay301_t963d4/Kconfig
```kconfig
# Copyright (c) 2021-2022 Amlogic, Inc. All rights reserved.

# SPDX-License-Identifier: MIT

config BOARD_AY301_T963D4
	bool "Amlogic AY301 Board"
	select SOC_T5M
	select LIBC_AML
	select COMMON
	select GET_VERSION
	select STICK_MEM
	select UART
	select CEC
	select MAILBOX
	select STR
	select GPIO
	select KEY
	select PWM
	select LEDS
	select TIMER_SOURCE
	select SARADC
	select IR
	select ETHERNET
	select VRTC
	select HWSPINLOCK
	select VERSION_FULL_INFO
	select HDMIRX
	select BL30_VERSION_SAVE
	select PM
	help
	  Enable Amlogic AY301 Board.
```

## bl30/rtos_sdk/boards/riscv/ay301_t963d4/defconfig
```kconfig
#
# Copyright (c) 2021-2022 Amlogic, Inc. All rights reserved.
#
# SPDX-License-Identifier: MIT
#
CONFIG_BOARD_AY301_T963D4=y
```

## bl30/rtos_sdk/boards/riscv/ba400_a113l2/Kconfig
```kconfig
# Copyright (c) 2021-2022 Amlogic, Inc. All rights reserved.

# SPDX-License-Identifier: MIT

config BOARD_BA400_A113L2
	bool "Amlogic BA400 Board"
	select SOC_A4
	select LIBC_AML
	select COMMON
	select GET_VERSION
	select STICK_MEM
	select UART
	select CEC
	select MAILBOX
	select STR
	select GPIO
	select KEY
	select PWM
	select LEDS
	select I2C_SLAVE
	select I2C
	select TIMER_SOURCE
	select SARADC
	select IR
	select ETHERNET
	select RTC
	select VERSION_FULL_INFO
	select RTC_STORAGE_FORMAT_GRAY
	select BL30_VERSION_SAVE
	help
	  Enable Amlogic BA400 Board.
```

## bl30/rtos_sdk/boards/riscv/ba400_a113l2/defconfig
```kconfig
#
# Copyright (c) 2021-2022 Amlogic, Inc. All rights reserved.
#
# SPDX-License-Identifier: MIT
#

CONFIG_BOARD_BA400_A113L2=y
```

## bl30/rtos_sdk/boards/riscv/ba409_a113l2/Kconfig
```kconfig
# Copyright (c) 2021-2022 Amlogic, Inc. All rights reserved.

# SPDX-License-Identifier: MIT

config BOARD_BA409_A113L2
	bool "Amlogic BA409 Board"
	select SOC_A4
	select LIBC_AML
	select COMMON
	select GET_VERSION
	select STICK_MEM
	select UART
	select CEC
	select MAILBOX
	select STR
	select GPIO
	select KEY
	select PWM
	select LEDS
	select TIMER_SOURCE
	select SARADC
	select IR
	select ETHERNET
	select RTC
	select VERSION_FULL_INFO
	select RTC_STORAGE_FORMAT_GRAY
	help
	  Enable Amlogic BA409 Board.
```

## bl30/rtos_sdk/boards/riscv/bc302_t968d4/Kconfig
```kconfig
# Copyright (c) 2021-2022 Amlogic, Inc. All rights reserved.

# SPDX-License-Identifier: MIT

config BOARD_BC302_T968D4
	bool "Amlogic BC302 Board"
	select SOC_T3X
	select LIBC_AML
	select COMMON
	select GET_VERSION
	select BL30_VERSION_SAVE
	select STICK_MEM
	select UART
	select CEC
	select MAILBOX
	select STR
	select GPIO
	select KEY
	select PWM
	select LEDS
	select TIMER_SOURCE
	select SARADC
	select IR
	select ETHERNET
	select VRTC
	select HWSPINLOCK
	select VERSION_FULL_INFO
	help
	  Enable Amlogic BC302 Board.
```

## bl30/rtos_sdk/boards/riscv/bc303_t968d4/defconfig
```kconfig
#
# Copyright (c) 2021-2022 Amlogic, Inc. All rights reserved.
#
# SPDX-License-Identifier: MIT
#

CONFIG_BOARD_BC303_T968D4=y
```

## bl30/rtos_sdk/boards/riscv/be309_t950s/Kconfig
```kconfig
# Copyright (c) 2021-2022 Amlogic, Inc. All rights reserved.

# SPDX-License-Identifier: MIT

config BOARD_BE309_T950S
	bool "Amlogic BE309_T950S Board"
	select SOC_TXHD2
	select LIBC_AML
	select COMMON
	select GET_VERSION
	select STICK_MEM
	select UART
	# select CEC
	select DDR
	select MAILBOX
	select VRTC
	select STR
	select GPIO
	select KEY
	select PWM
	# select LEDS
	select TIMER_SOURCE
	select SARADC
	select IR
	select ETHERNET
	select VERSION_FULL_INFO
	help
	  Enable Amlogic BE309_T950S Board.
```

## bl30/rtos_sdk/boards/riscv/be309_t950s/defconfig
```kconfig
#
# Copyright (c) 2021-2022 Amlogic, Inc. All rights reserved.
#
# SPDX-License-Identifier: MIT
#

CONFIG_BOARD_BE309_T950S=y
```

## bl30/rtos_sdk/boards/riscv/bg201_s805c1/defconfig
```kconfig
#
# Copyright (c) 2021-2022 Amlogic, Inc. All rights reserved.
#
# SPDX-License-Identifier: MIT
#
CONFIG_BOARD_BG201_S805C1=y
```

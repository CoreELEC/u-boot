## bl30/rtos_sdk/drivers_aocpu/hdmirx/Kconfig
```kconfig
# Copyright (c) 2021-2022 Amlogic, Inc. All rights reserved.

# SPDX-License-Identifier: MIT

config HDMIRX
	bool "hdmirx wakeup driver"
	help
	  hdmirx wake up
```

## bl30/rtos_sdk/drivers_aocpu/hwspinlock/Kconfig
```kconfig
# Copyright (c) 2021-2022 Amlogic, Inc. All rights reserved.

# SPDX-License-Identifier: MIT

config HWSPINLOCK
	bool "Hardware Spinlock Driver"
	help
	  hwspinlock driver
```

## bl30/rtos_sdk/drivers_aocpu/i2c/Kconfig
```kconfig
# Copyright (c) 2021-2022 Amlogic, Inc. All rights reserved.

# SPDX-License-Identifier: MIT

config I2C
	bool "I2C Driver"
	help
	  Enable I2C Driver.
```

## bl30/rtos_sdk/drivers_aocpu/i2c_slave/Kconfig
```kconfig
# Copyright (c) 2021-2022 Amlogic, Inc. All rights reserved.

# SPDX-License-Identifier: MIT

config I2C_SLAVE
	bool "I2C_SLAVE Driver"
	help
	  Enable I2C_SLAVE Driver.
```

## bl30/rtos_sdk/drivers_aocpu/ir/Kconfig
```kconfig
# Copyright (c) 2021-2022 Amlogic, Inc. All rights reserved.

# SPDX-License-Identifier: MIT

config IR
	bool "IR Driver"
```

## bl30/rtos_sdk/drivers_aocpu/pm/Kconfig
```kconfig
# Copyright (c) 2021-2022 Amlogic, Inc. All rights reserved.

# SPDX-License-Identifier: MIT

config PM
	bool "early suepnd Driver"
	help
	  Enable early suspend wake-up function
```

## bl30/rtos_sdk/drivers_aocpu/rtc/Kconfig
```kconfig
# Copyright (c) 2021-2022 Amlogic, Inc. All rights reserved.

# SPDX-License-Identifier: MIT

config RTC
	bool "RTC Driver"

config RTC_STORAGE_FORMAT_GRAY
	bool "RTC Storage Time Format"
	help
		"judge whether the rtc stores time with gray code"
```

## bl30/rtos_sdk/drivers_aocpu/str/Kconfig
```kconfig
# Copyright (c) 2021-2022 Amlogic, Inc. All rights reserved.

# SPDX-License-Identifier: MIT

config STR
	bool "STR suspend Driver"
```

## bl30/rtos_sdk/drivers_aocpu/timer_source/Kconfig
```kconfig
# Copyright (c) 2021-2022 Amlogic, Inc. All rights reserved.

# SPDX-License-Identifier: MIT

config TIMER_SOURCE
	bool "TimerSouece Driver"
```

## bl30/rtos_sdk/drivers_aocpu/uart/Kconfig
```kconfig
# Copyright (c) 2021-2022 Amlogic, Inc. All rights reserved.

# SPDX-License-Identifier: MIT

config UART
	bool "UART Driver"

if UART
config UART_WAKEUP
	bool "UART Wake up Function"
	help
	    help select uart wake up function setting.

endif # UART
```

## bl30/rtos_sdk/drivers_aocpu/wifi_bt_wake/Kconfig
```kconfig
# Copyright (c) 2021-2022 Amlogic, Inc. All rights reserved.

# SPDX-License-Identifier: MIT

config WIFI_BT_WAKE
	bool "WIFI BT Wake up Sampling"
	help
	    help select wifi/bt wake up function setting.
```

## bl30/rtos_sdk/kernel/freertos/Kconfig
```kconfig
# Copyright (c) 2021-2022 Amlogic, Inc. All rights reserved.

# SPDX-License-Identifier: MIT

config KERNEL
	bool "RTOS Kernel"
	default y
	help
	  Enable RTOS kernel.

if KERNEL

config KERNEL_ARCH_DIR
	string
	default "ARM_CA53_64_BIT" if ARM_CA53_64_BIT
	default "ARM_CA9" if ARM_CA9
	default "RISC-V" if RISCV
	default "Xtensa" if XTENSA
	help
	  System arch dir string.


config KERNEL_COMPILER_DIR
	string
	default "GCC" if ARM || ARM64
	default "GCC" if RISCV
	default "XCC" if XTENSA
	help
	  System compiler dir string.

config DMALLOC
	bool "Debug Memory Allocation"
	help
	  Enable the memory allocation statistics of tasks..

config DMALLOC_SIZE
	hex "Debug Memory Allocation Buffer Size"
	depends on DMALLOC
	default 128
	help
	  Set the buffer size of memory allocation statistics.

config MEMORY_ERROR_DETECTION
	bool "Memory Error Detection"
	help
	  Enable detecting out-of-bounds access, memory leaks.

config MEMORY_ERROR_DETECTION_SIZE
	hex "Memory Error Detection Buffer Size"
	depends on MEMORY_ERROR_DETECTION
	default 256
	help
	  Set the buffer size of memory error detection.

endif # KERNEL
```

## bl30/rtos_sdk/lib/libc/Kconfig
```kconfig
# Copyright (c) 2021-2022 Amlogic, Inc. All rights reserved.

# SPDX-License-Identifier: MIT

menuconfig LIBC
	bool "Generic_C_lib"
	help
	  Select generic C library

if LIBC
	rsource "aml/Kconfig"
	rsource "newlib/Kconfig"
	rsource "qlibc/Kconfig"
endif
```

## bl30/rtos_sdk/lib/libc/aml/Kconfig
```kconfig
# Copyright (c) 2021-2022 Amlogic, Inc. All rights reserved.

# SPDX-License-Identifier: MIT

config LIBC_AML
	bool "Libc implement by AML"
	select KERNEL
	help
		Enable libc of AML's implementation.

if LIBC_AML
config LIBC_AML_FLOAT_PRINT
	bool "Float number print supported"
	help
	  Float number print supported
endif
```

## bl30/rtos_sdk/lib/libc/logbuffer/Kconfig
```kconfig
# Copyright (c) 2021-2022 Amlogic, Inc. All rights reserved.

# SPDX-License-Identifier: MIT

config LOG_BUFFER
    bool "RAM Log Interface"
	select KERNEL
    help
      Enable RAM log function.

if LOG_BUFFER

config LOG_BUFFER_CACHE_LEN
	int "Log Buffer Cache Len"
	default 4096
	help
	  Maximum log cache length configuration.

endif
```

## bl30/rtos_sdk/lib/libc/newlib/Kconfig
```kconfig
# Copyright (c) 2021-2022 Amlogic, Inc. All rights reserved.

# SPDX-License-Identifier: MIT

config LIBC_STD
	bool "Libc implement by standard"
	select KERNEL
	help
		Enable libc of standard implementation.
```

## bl30/rtos_sdk/lib/libc/qlibc/Kconfig
```kconfig
# Copyright (c) 2021-2022 Amlogic, Inc. All rights reserved.

# SPDX-License-Identifier: MIT

config QLIBC
	bool "qlibc"
	select POSIX
	help
	  Providing generic data structures and algorithms

if QLIBC
config QLIBC_TEST
	bool "qlibc TEST"
	help
	  QLIBC unit test cases
endif
```

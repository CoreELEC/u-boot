## bl30/rtos_sdk/arch/riscv/Kconfig
```kconfig
# Copyright (c) 2021-2022 Amlogic, Inc. All rights reserved.

# SPDX-License-Identifier: MIT

menu "RISCV Options"

config RISCV
	bool
	select KERNEL
	help
	  RISC-V architecture

menu "Toolchain Options"
	rsource "toolchain/Kconfig"
endmenu

config VERSION_FULL_INFO
	bool "Version full information"
	help
	  Select print full version information.

config AOCPU_ALIVE_DETECTION
	bool "AOCPU alive detection mechanism"
	help
	  Record AOCPU tickcount to register.

config AOCPU_BUSRESPERR_DETECTION
	bool "AOCPU bus response error detection mechanism"
	help
	  Generate irq and show error pc and address.

config RISCV_WCN
	bool "RISCV for WCN"
	help
	  RISCV for WCN.

endmenu
```

## bl30/rtos_sdk/arch/riscv/toolchain/Kconfig
```kconfig
# Copyright (c) 2021-2022 Amlogic, Inc. All rights reserved.

# SPDX-License-Identifier: MIT

choice TOOLCHAIN
	bool "Toolchain selection"
	default TOOLCHAIN_GCC
	help
	  "Select toolchain"

	config TOOLCHAIN_GCC
	bool "GCC"
	help
	  "Select GCC toolchain"
endchoice

if TOOLCHAIN_GCC

config LTO_OPTIMIZATION
	bool "LTO flag"
	help
	  "Select The link-time optimizations flag"

config STACK_PROTECTOR_STRONG
	bool "stack protecter strong flag"
	help
	  "Select stack protecter string flag"

endif
```

## bl30/rtos_sdk/boards/riscv/bq201_s905d5/Kconfig
```kconfig
# Copyright (c) 2021-2022 Amlogic, Inc. All rights reserved.

# SPDX-License-Identifier: MIT

config BOARD_BQ201_S905D5
	bool "Amlogic BQ201_S905D5 Board"
	select SOC_S6
	select BRINGUP
	select LIBC_AML
	select COMMON
	select GET_VERSION
	select STICK_MEM
	select UART
	select CEC
	select MAILBOX
	select STR
	select GPIO
	select KEY
	select PWM
	select LEDS
#	select I2C_SLAVE
	select TIMER_SOURCE
	select SARADC
	select IR
	select ETHERNET
	select VRTC
	select VERSION_FULL_INFO
	help
	  Enable Amlogic BQ201_S905D5 Board.
```

## bl30/rtos_sdk/boards/riscv/bq201_s905d5/defconfig
```kconfig
#
# Copyright (c) 2021-2022 Amlogic, Inc. All rights reserved.
#
# SPDX-License-Identifier: MIT
#

CONFIG_BOARD_BQ201_S905D5=y
```

## bl30/rtos_sdk/boards/riscv/bq209_s905d5/Kconfig
```kconfig
# Copyright (c) 2021-2022 Amlogic, Inc. All rights reserved.

# SPDX-License-Identifier: MIT

config BOARD_BQ209_S905D5
	bool "Amlogic BQ209_S905D5 Board"
	select SOC_S6
	select LIBC_AML
	select COMMON
	select GET_VERSION
	select UART
	select CEC
	select MAILBOX
	select STR
	select GPIO
	select KEY
	select PWM
	select LEDS
#	select I2C_SLAVE
	select TIMER_SOURCE
	select SARADC
	select IR
	select ETHERNET
	select VRTC
	select VERSION_FULL_INFO
	help
	  Enable Amlogic BQ209_S905D5 Board.
```

## bl30/rtos_sdk/boards/riscv/br309_t950d5/Kconfig
```kconfig
# Copyright (c) 2021-2022 Amlogic, Inc. All rights reserved.

# SPDX-License-Identifier: MIT

config BOARD_BR309_T950D5
	bool "Amlogic BR309_T950D5 Board"
	select SOC_T6D
	select LIBC_AML
	select COMMON
	select GET_VERSION
	select UART
	select CEC
	select MAILBOX
	select STR
	select GPIO
	select KEY
	select PWM
	select LEDS
	select TIMER_SOURCE
	select SARADC
	select IR
	select ETHERNET
	select VRTC
	select HWSPINLOCK
	select VERSION_FULL_INFO
	select HDMIRX
	select PM
	select WIFI_BT_WAKE
	help
	  Enable Amlogic BR309_T950D5 Board.
```

## bl30/rtos_sdk/boards/riscv/s7d_odroidc5/Kconfig
```kconfig
# Copyright (c) 2025 Hardkernel Co., Ltd. All rights reserved.

# SPDX-License-Identifier: MIT

config BOARD_S7D_ODROIDC5
	bool "Hardkernel ODROID-C5"
	select SOC_S7D
	select LIBC_AML
	select COMMON
	select GET_VERSION
	select UART
	select CEC
	select MAILBOX
	select STR
	select GPIO
	select KEY
	select PWM
	select LEDS
	select TIMER_SOURCE
	select IR
	select ETHERNET
	select VRTC
	select VERSION_FULL_INFO
	help
	  Enable Hardkernel ODROID-C5 Board.
```

## bl30/rtos_sdk/boards/riscv/s7d_odroidc5/defconfig
```kconfig
#
# Copyright (c) 2025 Hardkernel Co., Ltd. All rights reserved.
#
# SPDX-License-Identifier: MIT
#

CONFIG_BOARD_S7D_ODROIDC5=y
```

## bl30/rtos_sdk/drivers_aocpu/spi/Kconfig
```kconfig
# Copyright (c) 2021-2022 Amlogic, Inc. All rights reserved.

# SPDX-License-Identifier: MIT

config SPI
	bool "SPI Driver"
	help
	  This enable SPI and SPICC Driver.

if SPI
config MBSPI
	bool "mailbox SPI driver"
	help
	  This enable mailbox SPI Driver.

config SPI_TEST
	bool "SPI test task"
	help
	  This is a SPI test task.
endif
```

## bl30/rtos_sdk/soc/riscv/a5/Kconfig
```kconfig
# Copyright (c) 2021-2022 Amlogic, Inc. All rights reserved.

# SPDX-License-Identifier: MIT

config SOC_A5
	bool "A5"
	select RISCV
	select STICK_MEM
	select AOCPU_ALIVE_DETECTION
	select AOCPU_BUSRESPERR_DETECTION
	help
	  Enable A5 SOC of RISCV.
```

## bl30/rtos_sdk/soc/riscv/s1a/Kconfig
```kconfig
# Copyright (c) 2021-2022 Amlogic, Inc. All rights reserved.

# SPDX-License-Identifier: MIT

config SOC_S1A
	bool "S1A"
	select RISCV
	select STICK_MEM
	select AOCPU_BUSRESPERR_DETECTION
	help
	  Enable S1A SOC of RISCV.
```

## bl30/rtos_sdk/soc/riscv/s5/Kconfig
```kconfig
# Copyright (c) 2021-2022 Amlogic, Inc. All rights reserved.

# SPDX-License-Identifier: MIT

config SOC_S5
	bool "S5"
	select RISCV
	select AOCPU_BUSRESPERR_DETECTION
	help
	  Enable S5 SOC of RISCV.
```

## bl30/rtos_sdk/soc/riscv/s6/Kconfig
```kconfig
# Copyright (c) 2021-2022 Amlogic, Inc. All rights reserved.

# SPDX-License-Identifier: MIT

config SOC_S6
	bool "S6"
	select RISCV
	select STICK_MEM
	select AOCPU_ALIVE_DETECTION
	select AOCPU_BUSRESPERR_DETECTION
	select BL30_VERSION_SAVE
	select STACK_PROTECTOR_STRONG
	help
	  Enable S6 SOC of RISCV.
```

## bl30/rtos_sdk/soc/riscv/s7/Kconfig
```kconfig
# Copyright (c) 2021-2022 Amlogic, Inc. All rights reserved.

# SPDX-License-Identifier: MIT

config SOC_S7
	bool "S7"
	select RISCV
	select STICK_MEM
	select AOCPU_ALIVE_DETECTION
	select AOCPU_BUSRESPERR_DETECTION
	help
	  Enable S7 SOC of RISCV.
```

## bl30/rtos_sdk/soc/riscv/s7d/Kconfig
```kconfig
# Copyright (c) 2021-2022 Amlogic, Inc. All rights reserved.

# SPDX-License-Identifier: MIT

config SOC_S7D
	bool "S7D"
	select RISCV
	select STICK_MEM
	select AOCPU_ALIVE_DETECTION
	select AOCPU_BUSRESPERR_DETECTION
	select BL30_VERSION_SAVE
	select STACK_PROTECTOR_STRONG
	help
	  Enable S7D SOC of RISCV.
```

## bl30/rtos_sdk/soc/riscv/t5m/Kconfig
```kconfig
# Copyright (c) 2021-2022 Amlogic, Inc. All rights reserved.

# SPDX-License-Identifier: MIT

config SOC_T5M
	bool "T5M"
	select RISCV
	select STICK_MEM
	select AOCPU_ALIVE_DETECTION
	select AOCPU_BUSRESPERR_DETECTION
	help
	  Enable T5M SOC of RISCV.
```

## bl30/rtos_sdk/soc/riscv/t6d/Kconfig
```kconfig
# Copyright (c) 2021-2022 Amlogic, Inc. All rights reserved.

# SPDX-License-Identifier: MIT

config SOC_T6D
	bool "T6D"
	select RISCV
	select STICK_MEM
	select AOCPU_ALIVE_DETECTION
	select AOCPU_BUSRESPERR_DETECTION
	select BL30_VERSION_SAVE
	select STACK_PROTECTOR_STRONG
	help
	  Enable T6D SOC of RISCV.
```

## bl30/rtos_sdk/soc/riscv/txhd2/Kconfig
```kconfig
# Copyright (c) 2021-2022 Amlogic, Inc. All rights reserved.

# SPDX-License-Identifier: MIT

config SOC_TXHD2
	bool "TXHD2"
	select RISCV
	select SOC_OLD_ARCH
	select AOCPU_BUSRESPERR_DETECTION
	help
	  Enable TXHD2 SOC of RISCV.
```
